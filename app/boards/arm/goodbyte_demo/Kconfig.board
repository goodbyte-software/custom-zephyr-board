## app/boards/arm/goodbyte_demo/Kconfig.board
```kconfig
config BOARD_GOODBYTE_DEMO
    bool "Goodbyte demo board"
    depends on SOC_NRF52832_QFAA
```

## app/boards/arm/goodbyte_demo/Kconfig.defconfig
```kconfig
if BOARD_GOODBYTE_DEMO

config BOARD
    default "goodbyte demo"

endif # BOARD_GOODBYTE_DEMO
```

## app/boards/arm/goodbyte_demo/goodbyte_demo_defconfig
```kconfig
CONFIG_SOC_SERIES_NRF52X=y
CONFIG_SOC_NRF52832_QFAA=y

# Enable MPU
CONFIG_ARM_MPU=y
CONFIG_GPIO=y
```

## west.yml
```yaml
manifest:
  remotes:
    - name: zephyrproject-rtos
      url-base: https://github.com/zephyrproject-rtos

  projects:
    - name: zephyr
      remote: zephyrproject-rtos
      revision: v3.6.0
      import:
        name-allowlist:
          - cmsis      # required by the ARM port
          - hal_nordic # required by nrf board
```
